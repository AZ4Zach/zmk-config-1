
  /*
  * Copyright (c) 2020 The ZMK Contributors
  *
  * SPDX-License-Identifier: MIT
  */

  #include <behaviors.dtsi>
  #include <dt-bindings/zmk/keys.h>
  #include <dt-bindings/zmk/bt.h>
  #include <dt-bindings/zmk/ext_power.h>

  / {
    keymap {
      compatible = "zmk,keymap";
  layer0 {
          bindings = <
          &kp ESCAPE &kp N1 &kp N2 &kp N3 &kp N4 &kp N5 &kp N6 &kp N7 &kp N8 &kp N9 &kp N0 &kp MINUS &kp EQUAL &kp BACKSPACE &trans &kp HOME &kp TAB &kp Q &kp W &kp E &kp R &kp T &kp Y &kp U &kp I &kp O &kp P &kp LEFT_BRACKET &kp RIGHT_BRACKET &kp BACKSLASH &kp PAGE_UP &kp CAPSLOCK &kp A &kp S &kp D &kp F &kp G &kp H &kp J &kp K &kp L &kp SEMICOLON &kp SINGLE_QUOTE &kp ENTER &kp PAGE_DOWN &kp LEFT_SHIFT &trans &kp Z &kp X &kp C &kp V &kp B &kp N &kp M &kp COMMA &kp DOT &kp SLASH &kp RIGHT_SHIFT &kp UP &kp END &kp LEFT_CONTROL &kp LEFT_GUI &kp LEFT_ALT &kp SPACE &kp RIGHT_ALT &mo 1 &kp RIGHT_CONTROL &kp LEFT &kp DOWN &kp RIGHT
          >;
        };layer1 {
          bindings = <
          &kp GRAVE &kp F1 &kp F2 &kp F3 &kp F4 &kp F5 &kp F6 &kp F7 &kp F8 &kp F9 &kp F10 &kp F11 &kp F12 &kp DELETE &trans &kp INSERT &trans &kp C_VOLUME_DOWN &kp C_MUTE &kp C_VOLUME_UP &trans &trans &trans &trans &kp PRINTSCREEN &kp SCROLLLOCK &kp PAUSE_BREAK &kp UP &trans &trans &trans &trans &kp C_PREVIOUS &kp C_PLAY_PAUSE &kp C_NEXT &trans &trans &trans &trans &kp HOME &kp PAGE_UP &kp LEFT &kp RIGHT &trans &trans &trans &trans &trans &trans &trans &trans QK_BOOT &trans &trans &kp END &kp PAGE_DOWN &kp DOWN &trans &kp PAGE_UP &trans &trans &trans &trans &trans &trans &trans &trans &kp HOME &kp PAGE_DOWN &kp END
          >;
        };
    };
  };
  
